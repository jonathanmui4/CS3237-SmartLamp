

#include <SPI.h>
#include <Wire.h>
#include <Adafruit_GFX.h>
#include <Adafruit_SSD1306.h>
#include "Arduino.h"
#include <WiFi.h>
#include "ESP32MQTTClient.h"

const char *ssid = "haihong";
const char *pass = "yuhaihong";
char *server = "mqtt://172.20.10.2";

char *subscribeTopic = "hello/laptop";
char *publishTopic = "hello/esp";


ESP32MQTTClient mqttClient; // all params are set later

#define OLED_RESET 0  // GPIO0
Adafruit_SSD1306 display(OLED_RESET);

#define NUMFLAKES 10
#define XPOS 0
#define YPOS 1
#define DELTAY 2


#define LOGO16_GLCD_HEIGHT 16
#define LOGO16_GLCD_WIDTH  16

void draw(const unsigned char* experession);

const unsigned char PROGMEM angry2[] = {0x00, 0x00, 0x00, 0x00, 0x00, 0x00, 0x00, 0x00, 0x00, 0x00, 0x00, 0x00, 0x00,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 0x00, 0x00};
const unsigned char PROGMEM angry3[] = {0x00, 0x00, 0x00, 0x00, 0x00, 0x00, 0x00, 0x00, 0x00, 0x00, 0x00, 0x00, 0x00,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 0x00, 0x00};
const unsigned char PROGMEM angry1[] = {0x00, 0x00, 0x00, 0x00, 0x00, 0x00, 0x00, 0x00, 0x00, 0x00, 0x00, 0x00, 0x00,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 0x00, 0x00};
const unsigned char PROGMEM angry4[] = {0x00, 0x00, 0x00, 0x00, 0x00, 0x00, 0x60, 0x00, 0x00, 0x00, 0x00, 0x00, 0x00,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 0x00, 0x00};
const unsigned char PROGMEM sleep1[] = {0x00, 0x00, 0x00, 0x00, 0x00, 0x00, 0x00, 0x00, 0x00, 0x00, 0x00, 0x00, 0x00,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 0x00, 0x00};
const unsigned char PROGMEM sleep2[] = {0x00, 0x00, 0x00, 0x00, 0x00, 0x00, 0x00, 0x00, 0x00, 0x00, 0x00, 0x00, 0x00,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 0x00, 0x00};
const unsigned char PROGMEM sleep3[] = {0x00, 0x00, 0x00, 0x00, 0x00, 0x00, 0x00, 0x00, 0x00, 0x00, 0x00, 0x00, 0x00,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 0x00, 0x00};
const unsigned char PROGMEM sleep4[] = {0x00, 0x00, 0x00, 0x00, 0x00, 0x00, 0x00, 0x00, 0x00, 0x00, 0x00, 0x00, 0x00,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 0x00, 0x00};
const unsigned char PROGMEM sleep5[] = {0x00, 0x00, 0x00, 0x00, 0x00, 0x00, 0x00, 0x00, 0x00, 0x00, 0x00, 0x00, 0x00,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 0x00, 0x00};
const unsigned char PROGMEM blink1[] = {0x00, 0x00, 0x00, 0x00, 0x00, 0x00, 0x00, 0x00, 0x00, 0x00, 0x00, 0x00, 0x00,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 0x00, 0x00};
const unsigned char PROGMEM start[] = {0x00, 0x00, 0x00, 0x00, 0x00, 0x00, 0x00, 0x00, 0x00, 0x00, 0x00, 0x00, 0x00,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 0x00, 0x00};
const unsigned char PROGMEM smile1[] = {0x00, 0x00, 0x00, 0x00, 0x00, 0x00, 0x00, 0x00, 0x00, 0x00, 0x00, 0x00, 0x00,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 0x00, 0x00};
const unsigned char PROGMEM blink2[] = {0x00, 0x00, 0x00, 0x00, 0x00, 0x00, 0x00, 0x00, 0x00, 0x00, 0x00, 0x00, 0x00,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 0x00, 0x00};
const unsigned char PROGMEM smile2[] = {0x00, 0x00, 0x00, 0x00, 0x00, 0x00, 0x00, 0x00, 0x00, 0x00, 0x00, 0x00, 0x00,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 0x00, 0x00};





void setup()   {
    Serial.begin(115200);
    delay(3000); // 3 second delay for recovery
  

      // Connect esp32 to WiFi
    WiFi.begin(ssid, pass);
    WiFi.setHostname("c3test");
    Serial.print("Connecting to WiFi");
    while (WiFi.status() != WL_CONNECTED) {
        Serial.print('.');
        delay(1000);
    }
  
      // Connecting esp32 to MQTT broker
    log_i();
    log_i("setup, ESP.getSdkVersion(): ");
    log_i("%s", ESP.getSdkVersion());
    mqttClient.enableDebuggingMessages();
    mqttClient.setURI(server);
    mqttClient.enableLastWillMessage("lwt", "I am going offline");
    mqttClient.setKeepAlive(30);
    mqttClient.loopStart();
    Serial.print("Connecting to MQTT broker");
    while (!mqttClient.isConnected()) {
        Serial.print('.');
        delay(1000);
    }

  // by default, we'll generate the high voltage from the 3.3v line internally! (neat!)
  display.begin(SSD1306_SWITCHCAPVCC, 0x3C);  // initialize with the I2C addr 0x3C (for the 64x48)
  // Clear the buffer.
  display.clearDisplay();

}

int count = 0;
int oled_state = 0;
int interval = 200;
//{0: default, blinking; 1: sitting, smile; 2: crouching/playphone, angry; 3: sleeping, sleep}
int loop_flag = 0; // set to 0 when each transit occors
int posture=0;
void loop() {

  if(oled_state==0){
    if(count==0 || count==interval*3 || count==interval*4){draw(start);}
    if(count==interval){draw(blink1);}
    if(count==interval*2){draw(blink2);}
  }

  if(oled_state==1){
      if(count==0){draw(start);}
      if(count==interval){draw(smile1);}
      if(count==interval*2 || count==interval*3){draw(smile2);}
      if(count==interval*4){draw(smile2); oled_state=0;}

  }

  if(oled_state==2){
    if(loop_flag==0){
      if(count==0){draw(start);}
      if(count==interval){draw(angry1);}
      if(count==interval*2){draw(angry2);}
      loop_flag = 1;
    }
    else{
      if(count==0 || count==interval*2){draw(angry3);}
      if(count==interval || count==interval*3 || count==interval*4){draw(angry4);}
    }
  }

  if(oled_state==3){
    if(loop_flag==0){
      if(count==0){draw(start);}
      if(count==interval){draw(sleep1);}
      loop_flag = 1;
    }
    else{
      if(count==0){draw(sleep2);}
      if(count==interval){draw(sleep3);}
      if(count==interval*2){draw(sleep4);}
      if(count==interval*3 || count==interval*4){draw(sleep5);}
    }
  }

count = (count + 1) % 1000;
delay(1);
}

void draw(const unsigned char* experession){
  display.drawBitmap(0, 0,  experession, 64, 48, 1);
  display.display();
  display.clearDisplay();
}

void onConnectionEstablishedCallback(esp_mqtt_client_handle_t client)
{
    if (mqttClient.isMyTurn(client)) // can be omitted if only one client
    {
        mqttClient.subscribe(subscribeTopic, [](const String &payload)
                             {Serial.printf("From %s received message: %s\n", subscribeTopic, payload.c_str()); 
                             if(strcmp(payload.c_str(), "sitting")==0){posture=1; oled_state=1;}
                             if(strcmp(payload.c_str(), "crouching")==0){posture=2; oled_state=2;}
                             if(strcmp(payload.c_str(), "sleeping")==0){posture=3; oled_state=3;}
                             if(strcmp(payload.c_str(), "playphone")==0){posture=4; oled_state=2;}
                             if(strcmp(payload.c_str(), "empty")==0){posture=5; oled_state=0;}
                             Serial.println(posture);
                             Serial.println(oled_state);
                             loop_flag = 0;
                             });
// {0: default, 1:'sitting', 2:'crouching', 3:'sleeping', 4:'playphone', 5:'empty'}

        mqttClient.subscribe("bar/#", [](const String &topic, const String &payload)
                             {Serial.printf("From %s received message: %s\n", subscribeTopic, payload.c_str()); 
                            if(strcmp(payload.c_str(), "sitting")==0){posture=1; oled_state=1;}
                             if(strcmp(payload.c_str(), "crouching")==0){posture=2; oled_state=2;}
                             if(strcmp(payload.c_str(), "sleeping")==0){posture=3; oled_state=3;}
                             if(strcmp(payload.c_str(), "playphone")==0){posture=4; oled_state=2;}
                             if(strcmp(payload.c_str(), "empty")==0){posture=5; oled_state=0;}
                             Serial.println(posture);
                             Serial.println(oled_state);
                             loop_flag = 0;
                             });

    }
}

esp_err_t handleMQTT(esp_mqtt_event_handle_t event)
{
    mqttClient.onEventCallback(event);
    return ESP_OK;
}
