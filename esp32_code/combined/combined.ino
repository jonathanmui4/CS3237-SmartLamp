
#include "Arduino.h"
#include <WiFi.h>
#include <FastLED.h>
#include <string.h>
#include <WiFiClientSecure.h>
#include <UniversalTelegramBot.h>
#include <ArduinoJson.h>
#include <SPI.h>
#include <Wire.h>
#include <Adafruit_GFX.h>
#include <Adafruit_SSD1306.h>
#include "secrets.h"  // AWS credentials and certificates
#include <MQTTClient.h>


FASTLED_USING_NAMESPACE

//--------- parameters for LED ---------------
#define DATA_PIN 5
#define LED_TYPE WS2812
#define COLOR_ORDER GRB
#define NUM_LEDS 24
CRGB leds[NUM_LEDS];

//---------- test with single LED ------------
// #define LEDPIN 5  // testing with single LED
// #define LEDCHANNEL 1
// #define LEDFREQ 5000
// #define LEDRESOLUTION 8

//--------- parmeters related to photoresistor -----
// You can't use the ADC on any of the ADC2 channels while WiFi is on: GPIO4, GPIO0, GPIO2, GPIO15, GPIO13, GPIO12, GPIO14, GPIO27, GPIO25 and GPIO26.
// But you can use ADC1, which uses pins GPIO36, GPIO37, GPIO38, GPIO39, GPIO32, GPIO33, GPIO34 and GPIO35.
#define PHOTO_PIN 33
#define STANDARD_BRIGHTNESS 96
#define STANDARD_PHOTO_READING 600  //measured in a standard environment where brightness=96
uint8_t PhotoPinReading;
uint8_t BRIGHTNESS = 96;  // brightness indicator for keep-on modes, to be adjusted in order to get PhotoPinReading close to STANDARD_PHOTO_READING
uint8_t brightness = 0;   //brightness indicator for breathing effect
int flag_up = 1;

float max(float x, float y) {
  if (x > y) {
    return x;
  } else {
    return y;
  }
}


//--------- parameters for OLED --------------
#define OLED_RESET 0  // GPIO0
Adafruit_SSD1306 display(OLED_RESET);

void draw(const unsigned char *experession);


int oled_state = 0;
int interval = 200;
//{0: default, blinking; 1: sitting, smile; 2: crouching/playphone, angry; 3: sleeping, sleep}
int loop_flag = 0;  // set to 0 when each transit occors

const unsigned char PROGMEM angry2[] = { 
  0x00, 0x00, 0x00, 0x00, 0x00, 0x00, 0x00, 0x00, 0x00, 0x00, 0x00, 0x00,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 0x00, 0x00 };
const unsigned char PROGMEM angry3[] = { 0x00, 0x00, 0x00, 0x00, 0x00, 0x00, 0x00, 0x00, 0x00, 0x00, 0x00, 0x00, 0x00,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 0x00, 0x00 };
const unsigned char PROGMEM angry1[] = { 0x00, 0x00, 0x00, 0x00, 0x00, 0x00, 0x00, 0x00, 0x00, 0x00, 0x00, 0x00, 0x00,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 0x00, 0x00 };
const unsigned char PROGMEM angry4[] = { 0x00, 0x00, 0x00, 0x00, 0x00, 0x00, 0x60, 0x00, 0x00, 0x00, 0x00, 0x00, 0x00,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 0x00, 0x00 };
const unsigned char PROGMEM sleep1[] = { 0x00, 0x00, 0x00, 0x00, 0x00, 0x00, 0x00, 0x00, 0x00, 0x00, 0x00, 0x00, 0x00,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 0x00, 0x00 };
const unsigned char PROGMEM sleep2[] = { 0x00, 0x00, 0x00, 0x00, 0x00, 0x00, 0x00, 0x00, 0x00, 0x00, 0x00, 0x00, 0x00,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 0x00, 0x00 };
const unsigned char PROGMEM sleep3[] = { 0x00, 0x00, 0x00, 0x00, 0x00, 0x00, 0x00, 0x00, 0x00, 0x00, 0x00, 0x00, 0x00,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 0x00, 0x00 };
const unsigned char PROGMEM sleep4[] = { 0x00, 0x00, 0x00, 0x00, 0x00, 0x00, 0x00, 0x00, 0x00, 0x00, 0x00, 0x00, 0x00,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 0x00, 0x00 };
const unsigned char PROGMEM sleep5[] = { 0x00, 0x00, 0x00, 0x00, 0x00, 0x00, 0x00, 0x00, 0x00, 0x00, 0x00, 0x00, 0x00,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 0x00, 0x00 };
const unsigned char PROGMEM blink1[] = { 0x00, 0x00, 0x00, 0x00, 0x00, 0x00, 0x00, 0x00, 0x00, 0x00, 0x00, 0x00, 0x00,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 0x00, 0x00 };
const unsigned char PROGMEM start[] = { 0x00, 0x00, 0x00, 0x00, 0x00, 0x00, 0x00, 0x00, 0x00, 0x00, 0x00, 0x00, 0x00,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 0x00, 0x00 };
const unsigned char PROGMEM smile1[] = { 0x00, 0x00, 0x00, 0x00, 0x00, 0x00, 0x00, 0x00, 0x00, 0x00, 0x00, 0x00, 0x00,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 0x00, 0x00 };
const unsigned char PROGMEM blink2[] = { 0x00, 0x00, 0x00, 0x00, 0x00, 0x00, 0x00, 0x00, 0x00, 0x00, 0x00, 0x00, 0x00,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 0x00, 0x00 };
const unsigned char PROGMEM smile2[] = { 0x00, 0x00, 0x00, 0x00, 0x00, 0x00, 0x00, 0x00, 0x00, 0x00, 0x00, 0x00, 0x00,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 0x00, 0x00 };


//--------- flag for mode selection ----------
int activity = 0;
int posture = 0;
// ML algorithm would classify activity as:
// {1: computer, 2: reading, 3: sleeping, 4: not present}
// ML algorithm would classify posture as:
// {1: good, 2: bad}
int count = 0;

//--------- WiFi and MQTT settings -----------
// const char *ssid = "haihong";
// const char *pass = "yuhaihong";
// char *server = "mqtt://172.20.10.2:1883";

WiFiClientSecure net = WiFiClientSecure();
MQTTClient mqttClient = MQTTClient(20000);


char *subscribeTopic1 = "laptop/activity";
char *subscribeTopic2 = "laptop/posture";
char *publishTopic = "hello/esp";

// ESP32MQTTClient mqttClient;  // all params are set later

//--------- For AWS MQTT ------------

void connectToAWS() {
  // Configure WiFiClientSecure to use the AWS IoT device credentials
  net.setCACert(AWS_CERT_CA);
  net.setCertificate(AWS_CERT_CRT);
  net.setPrivateKey(AWS_CERT_PRIVATE);
  // Connect to the MQTT broker on the AWS endpoint we defined earlier
  mqttClient.begin(AWS_IOT_ENDPOINT, 8883, net);
  // create a call back to receive messages

  Serial.print("Connecting to AWS IoT");
  while (!mqttClient.connected()) {
    Serial.print(".");
    vTaskDelay(100);
  }

  mqttClient.onMessage(messageHandler);
  // Subscribe to a topic
  mqttClient.subscribe(subscribeTopic1);
  mqttClient.subscribe(subscribeTopic2);
  Serial.println("AWS IoT Connected!");
}

void mqttLoopTask(void *pvParameters) {
  Serial.print("task running on core ");
  Serial.println(xPortGetCoreID());
  vTaskDelay(1000);
  for (;;) {
    if (!mqttClient.connected()) {
      Serial.println("MQTT disconnected.");
      //connectToAWS();  // Reconnect to AWS
    } else {
      Serial.println("MQTT connected.");
      mqttClient.loop();
    }
    vTaskDelay(pdMS_TO_TICKS(1000));  // Delay to free up CPU cycles
  }
}

String msg;
int receivedActivity = 0;
int receivedPosture = 0;
int sendReady = 0;

void messageHandler(String &topic, String &payload) {
  if (topic == subscribeTopic1) {
    Serial.printf("From %s received message: %s\n", subscribeTopic1, payload.c_str());
    if (strcmp(payload.c_str(), "computer") == 0) { activity = 1; }
    if (strcmp(payload.c_str(), "reading") == 0) { activity = 2; }
    if (strcmp(payload.c_str(), "sleeping") == 0) { activity = 3; }
    if (strcmp(payload.c_str(), "not present") == 0) { activity = 4; }

    Serial.println(activity);
    loop_flag = 0;
    receivedActivity = 1;
  }

  if (topic == subscribeTopic2) {
    Serial.printf("From %s received message: %s\n", subscribeTopic2, payload.c_str());
    if (strcmp(payload.c_str(), "good") == 0) { posture = 1; }
    if (strcmp(payload.c_str(), "bad") == 0) { posture = 2; }

    Serial.println(posture);
    loop_flag = 0;
    receivedPosture = 1;
  }
}


//--------- Telegram BOT ---------------------
#define BOTtoken "6430964381:AAGG6iPYHaT3j_TpbavN9vLWBqhG9PN7pV8"  // your Bot Token (Get from Botfather)
#define CHAT_ID "1169036837"
WiFiClientSecure client;
UniversalTelegramBot bot(BOTtoken, client);


//--------- RTOS related parameters ----------
hw_timer_t *My_timer = NULL;
int initiateConnect = 1;

// void onConnectionEstablishedCallback(esp_mqtt_client_handle_t client) {
//   vTaskDelay(10);
// }
// esp_err_t handleMQTT(esp_mqtt_event_handle_t event) {
//   mqttClient.onEventCallback(event);
//   return ESP_OK;
// }
void IRAM_ATTR onTimer() {
  initiateConnect = 1;
}



//--------- MQTT handler ----------------------
void handleMqtt(void *parameter) {
  Serial.print("task running on core ");
  Serial.println(xPortGetCoreID());
  while (1) {
    if (initiateConnect == 1) {
      initiateConnect = 0;

      // wait for WiFi connection
      WiFi.mode(WIFI_STA);
      WiFi.begin(WIFI_SSID, WIFI_PASSWORD);
      WiFi.setHostname("c3test");
      Serial.print("Connecting to WiFi");
      while (WiFi.status() != WL_CONNECTED) {
        Serial.println("Connecting to wifi...");
        vTaskDelay(100);
        if (initiateConnect == 1) {
          break;
        }
      }
      Serial.println("WIFI CONNECTED");

      // wait for MQTT connection
      // log_i();
      // log_i("setup, ESP.getSdkVersion(): ");
      // log_i("%s", ESP.getSdkVersion());
      // mqttClient.enableDebuggingMessages();
      // mqttClient.setURI(server);
      // mqttClient.enableLastWillMessage("lwt", "I am going offline");
      // mqttClient.setKeepAlive(30);
      // mqttClient.loopStart();
      // Serial.print("Connecting to MQTT broker");
      // while (!mqttClient.isConnected()) {
      //   Serial.println("Connecting to MQTT...");
      //   vTaskDelay(100);
      //   if (initiateConnect == 1) {
      //     break;
      //   }
      // }
      connectToAWS();

      Serial.println("Connected!");


      while (mqttClient.connected()) {
        // if (sendReady == 0) {
        //   msg = "Ready!";
        //   mqttClient.publish("ready/bar", msg, 0, false);
        //   Serial.println(msg);
        //   sendReady = 1;
        // }


        if (receivedActivity && receivedPosture) {
          Serial.println("Received!");
          if (posture == 2 && activity != 3 && activity != 4) {
            bot.sendMessage(CHAT_ID, "Adjust your posture", "");
            vTaskDelay(500);
          }
          WiFi.disconnect();
          while (WiFi.status() == WL_CONNECTED) {
            vTaskDelay(1);
            Serial.print("Wifi Disconnecting...");
          }
          receivedPosture = 0;
          receivedActivity = 0;
          //sendReady = 0;
        }
      }
      //vTaskDelete(NULL);
    }
    vTaskDelay(1);
  }
}


//--------- LED handler --------------
void handleLED(void *parameter) {
  Serial.print("task running on core ");
  Serial.println(xPortGetCoreID());
  while (1) {
    BRIGHTNESS = max(96 + 0.5 * (600 - analogRead(PHOTO_PIN)), 0.0);
    //Not present
    if (activity == 4) {
      // Turn off all the LEDS.
      FastLED.setBrightness(0);
      FastLED.show();
      // Turn off the OLED.
      display.clearDisplay();
      display.display();

    } else if (activity == 3) {
      //LED breathing effect
      for (int i = 0; i < NUM_LEDS; i++) { leds[i] = CRGB::White; }
      if (count % 100 == 0) {
        if (flag_up == 1 && brightness < 10) {
          brightness++;
          if (brightness == 10) { flag_up = 0; }
        }
        if (flag_up == 0 && brightness > 0) {
          brightness--;
          if (brightness == 0) { flag_up = 1; }
        }
        // ledcWrite(LEDCHANNEL, brightness);
        FastLED.setBrightness(brightness);
        FastLED.show();
      }
      //OLED sleeping
      if (loop_flag == 0) {
        if (count == 0) { draw(start); }
        if (count == interval) { draw(sleep1); }
        loop_flag = 1;
      } else {
        if (count == 0) { draw(sleep2); }
        if (count == interval) { draw(sleep3); }
        if (count == interval * 2) { draw(sleep4); }
        if (count == interval * 3 || count == interval * 4) { draw(sleep5); }
      }
    } else if (posture == 2) {
      //LED warning effect
      for (int i = 0; i < NUM_LEDS; i++) { leds[i] = CRGB::Red; }
      if (flag_up == 1 && brightness < 254) {
        brightness++;
        if (brightness == 254) { flag_up = 0; }
      }
      if (flag_up == 0 && brightness > 0) {
        brightness--;
        if (brightness == 0) { flag_up = 1; }
      }
      FastLED.setBrightness(brightness);
      FastLED.show();
      //OLED angry
      if (loop_flag == 0) {
        if (count == 0) { draw(start); }
        if (count == interval) { draw(angry1); }
        if (count == interval * 2) { draw(angry2); }
        loop_flag = 1;
      } else {
        if (count == 0 || count == interval * 2) { draw(angry3); }
        if (count == interval || count == interval * 3 || count == interval * 4) { draw(angry4); }
      }
    } else if (activity == 0 || activity == 1 || activity == 2) {
      //OLED Blinking
      if (count == 0 || count == interval * 3 || count == interval * 4) { draw(start); }
      if (count == interval) { draw(blink1); }
      if (count == interval * 2) { draw(blink2); }
      //LED brightness affected by photoresistor
      if (activity == 2) {
        //Warm light for reading
        for (int i = 0; i < NUM_LEDS; i++) { leds[i] = CRGB::Yellow; }
        FastLED.setBrightness(BRIGHTNESS);
        FastLED.show();
      } else {
        //White light for startup and computer use
        for (int i = 0; i < NUM_LEDS; i++) { leds[i] = CRGB::White; }
        FastLED.setBrightness(BRIGHTNESS);
        FastLED.show();
      }
    }
    count = (count + 1) % 1000;
    vTaskDelay(1);
  }
}





void setup() {
  Serial.begin(115200);
  delay(3000);

  // tell FastLED about the LED strip configuration
  //FastLED.addLeds<LED_TYPE,DATA_PIN,COLOR_ORDER>(leds, NUM_LEDS).setCorrection(TypicalLEDStrip);

  // testing with single LED
  // ledcSetup(LEDCHANNEL, LEDFREQ, LEDRESOLUTION);
  // ledcAttachPin(LEDPIN, LEDCHANNEL);
  // ledcWrite(LEDCHANNEL, BRIGHTNESS);

  My_timer = timerBegin(0, 80, true);
  timerAttachInterrupt(My_timer, &onTimer, true);
  timerAlarmWrite(My_timer, 1000000 * 20, true);
  timerAlarmEnable(My_timer);  //Just Enable

  // tell FastLED about the LED strip configuration
  FastLED.addLeds<LED_TYPE, DATA_PIN, COLOR_ORDER>(leds, NUM_LEDS).setCorrection(TypicalLEDStrip);
  //FastLED.addLeds<LED_TYPE,DATA_PIN,CLK_PIN,COLOR_ORDER>(leds, NUM_LEDS).setCorrection(TypicalLEDStrip);

  // telegram bot start up
  client.setCACert(TELEGRAM_CERTIFICATE_ROOT);  // Add root certificate for api.telegram.org
  bot.sendMessage(CHAT_ID, "Bot started up", "");

  // initialize OLED
  display.begin(SSD1306_SWITCHCAPVCC, 0x3C);  // initialize with the I2C addr 0x3C (for the 64x48)
  display.clearDisplay();


  // Task to run forever
  xTaskCreatePinnedToCore(  // Use xTaskCreate() in vanilla FreeRTOS
    handleMqtt,             // Function to be called
    "Handle Mqtt",          // Name of task
    8192,                   // Stack size (bytes in ESP32, words in FreeRTOS)
    NULL,                   // Parameter to pass to function
    1,                      // Task priority (0 to configMAX_PRIORITIES - 1)
    NULL,                   // Task handle
    0);                     // Run on one core for demo purposes (ESP32 only)

  // xTaskCreatePinnedToCore(  // Use xTaskCreate() in vanilla FreeRTOS
  //   handleLED,              // Function to be called
  //   "Handle LEDs",          // Name of task
  //   4096,                   // Stack size (bytes in ESP32, words in FreeRTOS)
  //   NULL,                   // Parameter to pass to function
  //   1,                      // Task priority (0 to configMAX_PRIORITIES - 1)
  //   NULL,                   // Task handle
  //   0);        // Run on one core for demo purposes (ESP32 only)

  xTaskCreatePinnedToCore(mqttLoopTask, "MQTTTask", 10000, NULL, 1, NULL, 1);
  //connectWifiandMqtt();
  //vTaskDelete(NULL);

  delay(10000);
}

void loop() {
}

void draw(const unsigned char *experession) {
  display.drawBitmap(0, 0, experession, 64, 48, 1);
  display.display();
  display.clearDisplay();
}
